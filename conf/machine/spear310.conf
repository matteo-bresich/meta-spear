## conf/machine/spear310.conf
```bitbake
#@TYPE: Machine
#@NAME: spear310 machine
#@DESCRIPTION: 

require conf/machine/include/tune-arm926ejs.inc

PREFERRED_PROVIDER_virtual/kernel ?= "linux-yocto"
PREFERRED_VERSION_linux-yocto ?= "5.4%"
KERNEL_IMAGETYPE = "zImage"
KERNEL_DEVICETREE = "spear310-evb.dtb"
KERNEL_DEVICETREE_BUNDLE = "1"
KERNEL_EXTRA_ARGS += "LOADADDR=${UBOOT_ENTRYPOINT}"

SERIAL_CONSOLES ?= "115200;ttyS0"
SERIAL_CONSOLES_CHECK = "${SERIAL_CONSOLES}"

IMAGE_FSTYPES += "tar.bz2 jffs2 ext3"
EXTRA_IMAGECMD_jffs2 = "-lnp "

#EXTRA_IMAGEDEPENDS += "u-boot"
UBOOT_MACHINE_spear310 = "spear310_defconfig"
UBOOT_ENTRYPOINT = "0x00000000"
UBOOT_LOADADDRESS = "0x00700000"

MACHINE_FEATURES = "vfat"

IMAGE_BOOT_FILES ?= "zImage spear310-evb.dtb"
```

## conf/machine/test.conf
```bitbake
#@TYPE: Machine
#@NAME: test machine
#@DESCRIPTION: Test for test machine

#require conf/machine/include/qemu.inc
#DEFAULTTUNE ?= "arm926ejs"
require conf/machine/include/tune-arm926ejs.inc

MACHINE_EXTRA_RRECOMMENDS = "kernel-modules kernel-devicetree"
EXTRA_IMAGEDEPENDS += "u-boot"

IMAGE_FSTYPES += "tar.bz2 jffs2 wic wic.bmap"
EXTRA_IMAGECMD_jffs2 = "-lnp "
WKS_FILE ?= "test.wks"

IMAGE_INSTALL_append = " kernel-devicetree kernel-image-zimage"
do_image_wic[depends] += "mtools-native:do_populate_sysroot dosfstools-native:do_populate_sysroot"

SERIAL_CONSOLES ?= "115200;ttyS0"
SERIAL_CONSOLES_CHECK = "${SERIAL_CONSOLES}"

PREFERRED_PROVIDER_virtual/kernel ?= "linux-yocto"
PREFERRED_VERSION_linux-yocto ?= "5.4%"

KERNEL_IMAGETYPE = "zImage"

KERNEL_DEVICETREE = "spear310-evb.dtb"
KERNEL_DEVICETREE_BUNDLE = "1"
KERNEL_EXTRA_ARGS += "LOADADDR=${UBOOT_ENTRYPOINT}"

SERIAL_CONSOLES = "115200;ttyS0"

# --- BOOTLOADER ---

#EXTRA_IMAGEDEPENDS += "u-boot"
#SPL_BINARY = "MLO"
#UBOOT_SUFFIX = "bin"
UBOOT_MACHINE_test = "spear310_defconfig"
UBOOT_ENTRYPOINT = "0x00000000"
UBOOT_LOADADDRESS = "0x00700000"

MACHINE_FEATURES = "usbgadget usbhost vfat"

#IMAGE_BOOT_FILES ?= "u-boot.${UBOOT_SUFFIX} MLO zImage spear310-evb.dtb"
IMAGE_BOOT_FILES ?= "zImage spear310-evb.dtb"

# For runqemu
#QB_SYSTEM_NAME = "qemu-system-arm"
#QB_MACHINE = "-machine versatilepb"
#QB_KERNEL_CMDLINE_APPEND = "console=ttyAMA0,115200 console=tty"
#QB_OPT_APPEND = "-show-cursor -usb -device usb-tablet"
# Add the 'virtio-rng-pci' device otherwise the guest may run out of entropy
#QB_OPT_APPEND += "-object rng-random,filename=/dev/urandom,id=rng0 -device virtio-rng-pci,rng=rng0"

IMAGE_ROOTFS_SIZE = "16384"
```

## meta-spear/conf/layer.conf
```bitbake
# We have a conf and classes directory, add to BBPATH
BBPATH .= ":${LAYERDIR}"

# We have recipes-* directories, add to BBFILES
BBFILES += "${LAYERDIR}/recipes-*/*/*.bb \
            ${LAYERDIR}/recipes-*/*/*.bbappend"

BBFILE_COLLECTIONS += "meta-spear"
BBFILE_PATTERN_meta-spear = "^${LAYERDIR}/"
BBFILE_PRIORITY_meta-spear = "5"

LAYERDEPENDS_meta-spear = "core"
LAYERSERIES_COMPAT_meta-spear = "dunfell"
```
